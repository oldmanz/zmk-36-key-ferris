## boards/shields/zweep/Kconfig.defconfig
```kconfig
# Copyright (c) 2020 The ZMK Contributors
# SPDX-License-Identifier: MIT

if SHIELD_ZWEEP_LEFT

config ZMK_KEYBOARD_NAME
	default "Zweep"

config ZMK_SPLIT_BLE_ROLE_CENTRAL
	default y

endif

if SHIELD_ZWEEP_LEFT || SHIELD_ZWEEP_RIGHT

config ZMK_SPLIT
	default y

endif
```

## config/boards/shields/zweep/Kconfig.shield
```kconfig
# Copyright (c) 2020 The ZMK Contributors
# SPDX-License-Identifier: MIT

config SHIELD_ZWEEP_LEFT
	def_bool $(shields_list_contains,zweep_left)

config SHIELD_ZWEEP_RIGHT
	def_bool $(shields_list_contains,zweep_right)
	
```
